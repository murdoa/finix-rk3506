## pkgs/u-boot-dts/rk3506_luckfox_usbplug_defconfig
```kconfig
# RK3506 usbplug: U-Boot built as USB flash firmware replacement.
#
# Based on rockchip-usbplug_defconfig with RK3506-specific overrides.
# Replaces the proprietary rk3506_usbplug_v1.03.bin which corrupts
# page 63 of random erase blocks on SPI NAND writes.
#
# Boot flow: BootROM → DDR init blob → this usbplug → rockusb loop
# Host uses rkdeveloptool as normal; writes go through U-Boot's MTD stack.

# --- Architecture / SoC ---
CONFIG_ARM=y
# CONFIG_ARM_SMCCC is not set
CONFIG_ARCH_ROCKCHIP=y
CONFIG_ROCKCHIP_RK3506=y
CONFIG_TARGET_EVB_RK3506=y
CONFIG_DEFAULT_DEVICE_TREE="rk3506-luckfox"

# --- Usbplug mode ---
CONFIG_SUPPORT_USBPLUG=y
# CONFIG_SPL is not set
# CONFIG_RKIMG_BOOTLOADER is not set
# CONFIG_ROCKCHIP_PRELOADER_ATAGS is not set
# CONFIG_GICV2 is not set

# --- Minimal command set ---
# CONFIG_CMDLINE is not set
CONFIG_U_BOOT_CMD_ALWAYS=y
# CONFIG_AUTOBOOT is not set
# CONFIG_FASTBOOT is not set
# CONFIG_CMD_BDI is not set
# CONFIG_CMD_CONSOLE is not set
# CONFIG_CMD_BOOTD is not set
# CONFIG_CMD_BOOTM is not set
# CONFIG_CMD_ELF is not set
# CONFIG_CMD_FDT is not set
# CONFIG_CMD_GO is not set
# CONFIG_CMD_RUN is not set
# CONFIG_CMD_IMI is not set
# CONFIG_CMD_IMLS is not set
# CONFIG_CMD_XIMG is not set
# CONFIG_CMD_EXPORTENV is not set
# CONFIG_CMD_IMPORTENV is not set
# CONFIG_CMD_EDITENV is not set
# CONFIG_CMD_SAVEENV is not set
# CONFIG_CMD_ENV_EXISTS is not set
# CONFIG_CMD_CRC32 is not set
# CONFIG_CMD_MEMORY is not set
# CONFIG_CMD_DM is not set
# CONFIG_CMD_FLASH is not set
# CONFIG_CMD_FPGA is not set
# CONFIG_CMD_LOADB is not set
# CONFIG_CMD_LOADS is not set
# CONFIG_CMD_ECHO is not set
# CONFIG_CMD_ITEST is not set
# CONFIG_CMD_SOURCE is not set
# CONFIG_CMD_SETEXPR is not set
# CONFIG_CMD_NET is not set
# CONFIG_CMD_NFS is not set
# CONFIG_CMD_MISC is not set
# CONFIG_CMD_PXE is not set
CONFIG_CMD_ROCKUSB=y

# --- Debug UART ---
CONFIG_DEBUG_UART=y
CONFIG_DEBUG_UART_BASE=0xff0a0000
CONFIG_DEBUG_UART_CLOCK=24000000
CONFIG_DEBUG_UART_SHIFT=2
CONFIG_BAUDRATE=1500000

# --- Memory ---
CONFIG_SYS_MALLOC_F_LEN=0xc000

# --- DM / OF ---
CONFIG_OF_SPL_REMOVE_PROPS="pinctrl-0 pinctrl-names interrupt-parent assigned-clocks assigned-clock-rates assigned-clock-parents"
# CONFIG_DM_WARN is not set
# CONFIG_DM_DEVICE_REMOVE is not set
# CONFIG_DM_STDIO is not set
# CONFIG_DM_SEQ_ALIAS is not set
CONFIG_REGMAP=y
CONFIG_SYSCON=y
# CONFIG_SIMPLE_BUS is not set
# CONFIG_OF_TRANSLATE is not set
# CONFIG_ADC is not set
# CONFIG_SARADC_ROCKCHIP is not set

# --- Clocks / Pinctrl / GPIO ---
CONFIG_CLK=y
CONFIG_PINCTRL=y
CONFIG_PINCTRL_ROCKCHIP=y
CONFIG_ROCKCHIP_GPIO=y
CONFIG_ROCKCHIP_GPIO_V2=y

# --- SPI NAND via SFC ---
CONFIG_ROCKCHIP_SFC=y
CONFIG_MTD=y
CONFIG_MTD_BLK=y
CONFIG_MTD_DEVICE=y
CONFIG_MTD_SPI_NAND=y
CONFIG_SPI_FLASH=y
CONFIG_SF_DEFAULT_MODE=0x1
CONFIG_SF_DEFAULT_SPEED=50000000
CONFIG_SPI_FLASH_SFDP_SUPPORT=y
CONFIG_SPI_FLASH_WINBOND=y
CONFIG_SPI_FLASH_GIGADEVICE=y
CONFIG_SPI_FLASH_MACRONIX=y
CONFIG_SPI_FLASH_XMC=y
CONFIG_SPI_FLASH_MTD=y
CONFIG_ROCKCHIP_NEW_IDB=y
# Disable flash-based BBT — the usbplug writes raw images, not Rockchip BBT format.
# Without this, the BBT scan fails on a flashed device and mtd_blk reports lba=0.
# CONFIG_MTD_NAND_BBT_USING_FLASH is not set

# --- MMC (for device scan) ---
CONFIG_MMC_DW=y
CONFIG_MMC_DW_ROCKCHIP=y

# --- USB Gadget: DWC2 OTG ---
CONFIG_USB=y
CONFIG_USB_GADGET=y
CONFIG_USB_GADGET_MANUFACTURER="Rockchip"
CONFIG_USB_GADGET_VENDOR_NUM=0x2207
CONFIG_USB_GADGET_PRODUCT_NUM=0x350f
CONFIG_USB_GADGET_DWC2_OTG=y
CONFIG_USB_GADGET_VBUS_DRAW=500
CONFIG_USB_GADGET_DOWNLOAD=y
CONFIG_USB_FUNCTION_MASS_STORAGE=y

# --- PHY ---
CONFIG_PHY_ROCKCHIP_INNO_USB2=y

# --- Sysreset ---
CONFIG_SYSRESET=y

# --- Display (not needed) ---
# CONFIG_SYS_WHITE_ON_BLACK is not set
# CONFIG_DISPLAY_CPUINFO is not set
# CONFIG_DISPLAY_BOARDINFO is not set
# CONFIG_ARCH_FIXUP_FDT_MEMORY is not set
# CONFIG_PASS_DEVICE_SERIAL_BY_FDT is not set

# --- Misc ---
CONFIG_USE_TINY_PRINTF=y
# CONFIG_SYSMEM is not set
# CONFIG_BIDRAM is not set
# CONFIG_EFI_LOADER is not set
# CONFIG_REQUIRE_SERIAL_CONSOLE is not set
# CONFIG_SERIAL_PRESENT is not set
# CONFIG_SPL_SERIAL_PRESENT is not set
```
